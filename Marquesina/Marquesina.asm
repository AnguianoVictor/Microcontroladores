PROCESSOR P16F887
INCLUDE<P16F887.INC>
__CONFIG _CONFIG1,(_INTRC_OSC_NOCLKOUT & _WDT_OFF & _PWRTE_OFF & _MCLRE_OFF &_CP_OFF & _CPD_OFF & _BOR_OFF & _IESO_OFF &_FCMEN_OFF & _LVP_OFF & _DEBUG_OFF)

__CONFIG _CONFIG2,(_WRT_OFF & _BOR40V)

;----DefiniciСn de variables
			VA EQU 0X21
			VB EQU 0X22
			VC EQU 0X23

			VX 	EQU 0X30
			CONTA EQU 0X31
			C8 	EQU 0X40
			C7 	EQU 0X41
			C6 	EQU 0X42
			C5 	EQU 0X43
			C4 	EQU 0X44
			C3 	EQU 0X45
			C2 	EQU 0X46
			C1 	EQU 0X47
			VER	EQU	0X50


			ORG			0X00
			GOTO 		INICIO
			INCLUDE<NOMBRE.ASM>
			INCLUDE<DENUEVO.ASM>
INICIO
			BANKSEL		ANSEL
			MOVLW		0XE0
			MOVWF		ANSEL
			CLRF		ANSELH
			
			BANKSEL		TRISA
			MOVLW		0XFF
			MOVWF		TRISA ;ENTRADAS
			CLRF		TRISB ;SALIDADS
			CLRF		TRISC

			MOVLW		0X07 
			MOVWF		TRISD
			MOVWF		TRISE
			
			BANKSEL		PORTA

			;PORTC: COL 
			;PORTB: ROW
;Se ponen en cero todas las variables
			CLRF		VX
			CLRF		C1
			CLRF		C2
			CLRF		C3
			CLRF		C4
			CLRF		C5
			CLRF		C6
			CLRF		C7
			CLRF		C8
			CLRF		VER
			
			MOVLW		.1
			MOVWF		CONTA

SACANOMBRE		
			MOVLW		0X01
			MOVWF		PORTB
			MOVF		C2,W
			MOVWF		C1
			MOVF		C1,W
			MOVWF		PORTC
			CALL		RETARDO

			MOVLW		0X02  
			MOVWF		PORTB
			MOVF		C3,W
			MOVWF		C2
			MOVF		C2,W
			MOVWF		PORTC
			CALL		RETARDO

			MOVLW		0X04
			MOVWF		PORTB
			MOVF		C4,W
			MOVWF		C3
			MOVF		C3,W
			MOVWF		PORTC
			CALL		RETARDO

			MOVLW		0X08
			MOVWF		PORTB
			MOVF		C5,W
			MOVWF		C4
			MOVF		C4,W
			MOVWF		PORTC
			CALL		RETARDO


			MOVLW		0X10
			MOVWF		PORTB
			MOVF		C6,W
			MOVWF		C5
			MOVF		C5,W
			MOVWF		PORTC
			CALL		RETARDO

			MOVLW		0X20
			MOVWF		PORTB
			MOVF		C7,W
			MOVWF		C6
			MOVF		C6,W
			MOVWF		PORTC
			CALL		RETARDO


			MOVLW		0X40
			MOVWF		PORTB
			MOVF		C8,W
			MOVWF		C7
			MOVF		C7,W
			MOVWF		PORTC
			CALL		RETARDO

			MOVLW		0X80
			MOVWF		PORTB
			CALL 		FILAS
			MOVWF		C8
			MOVWF		PORTC
			CALL		RETARDO
;----------------------------------------------

			CALL		MUESTRA

;---------------------------------------------
			DECFSZ		CONTA,F
			GOTO		SACANOMBRE

			INCF		VX,F
			MOVLW		.1
			MOVWF		CONTA


		
			MOVLW		.110
			XORWF		VX,W
			BTFSC		STATUS,Z   ;SI ES CERO SALTA Y REPITE
			GOTO		BORRA 
			GOTO		SACANOMBRE

	
FILAS		MOVF		VX,W  ;CONTADOR
			CALL		DATOS
			RETURN


BORRA		CLRF		VX
			GOTO		SACANOMBRE

;RETARDO 800 us

	RETARDO		MOVLW	   .1
				MOVWF		VC   
				
	C_C 		MOVLW		.7
				MOVWF 		VB
	C_B			MOVLW		.6
				MOVWF		VA
	C_A			NOP
				DECFSZ		VA,F
				GOTO 		C_A
				DECFSZ		VB,F
				GOTO 		C_B
				DECFSZ		VC,F
				GOTO 		C_C
				RETURN

			END
			