		PROCESSOR	PIC16F887
		INCLUDE		<P16F887.INC>
		
		__CONFIG _CONFIG1, (_INTRC_OSC_NOCLKOUT & _WDT_OFF & _PWRTE_OFF & _MCLRE_OFF & _CP_OFF & _CPD_OFF & _BOR_OFF & _IESO_OFF & _FCMEN_OFF & _LVP_OFF & _DEBUG_OFF)
		__CONFIG _CONFIG2, (_WRT_OFF & _BOR40V)
		
;----- VARIABLES A UTILIZAR. 
DIN		EQU		0x21
DOUT	EQU		0x22
DUTYON	EQU		0x23
DUTYOFF EQU		0x24
LSB		EQU		0x25
;-----COMIENZO DE PROGRAMA.
		ORG		0x00
		
;-----GESTION DE ENTRADAS ANALOGICAS. 
	;------BANCO 3
		
		BANKSEL		ANSEL
		MOVLW		b'00100000'
		MOVWF		ANSEL				;AN5-RE0 habilitda
		CLRF		ANSELH

;-----REGISTROS DE CONFIGURACION
	;------BANCO 1
		BANKSEL		TRISA
		MOVLW		b'00100000'			
		MOVWF		TRISA				;RA5 como entrada SPI-SS
		CLRF		TRISB
		MOVLW		b'00011000'			
		MOVWF		TRISC				;RC2 como salida CCP1
										;RC3 como entrada SCK
										;RC4 como entrada de datos SPI-SDI
										;RC5 como salida de datos SPI-SDO
		MOVLW		b'11111111'			
		MOVWF		TRISD				;Puerto D como entrada digital
		MOVLW		b'00000001'
		MOVWF		TRISE				;Re0 como entrada analogica
		;----CONFIGURANDO SSPCON2
		MOVLW		0x00
		MOVWF		SSPCON2				;Modulo I2C apagado
		;----CONFIGURANDO SSPSTAT
		MOVLW		0x00		
		MOVWF		SSPSTAT				;
		;----CONFIGURANDO TRM0 COMO CONTADOR 
		MOVLW		0xD7				;Prescaler 256 TMR0
		MOVWF		OPTION_REG
		;----CONFIGURANDO REGISTRO ADCON1
		CLRF		ADCON1				;Justificacion izquierda.
		MOVLW		0xBF
		MOVWF		PR2
	;------BANCO 0
		BANKSEL		PORTA
		;CLRF		PORTA
		CLRF		PORTB
		CLRF		PORTC
		;CLRF		PORTD
		;CLRF		PORTE
		;-----LIMPIAR BUFER SPI
		CLRF		SSPBUF
		;-----HABILITAR INTERRUPCIONES
		BSF			INTCON,T0IE
		;-----CONFIGURACION SSPCON
		MOVLW		0x24		;CKP=0
		MOVWF		SSPCON
		;----CONFIGURANDO ADCON0
		MOVLW		0x15		;Fosc/2 AN5 
		MOVWF		ADCON0

		

;-------INICIO DE FUNCIONALIDAD

MAIN		;----- Se envнa basura y se recibe PORTD(Se muestra en PORTB)
			NOP
			BANKSEL		TRISA
			BTFSS		SSPSTAT,BF
			GOTO		$-1
			BANKSEL		PORTA			;BANCO 0
			MOVF		SSPBUF,W		
			MOVWF		PORTB
		
		;-----Se envнa PORTD y se recibe 8Bits ADC (Se muestra en PWM)
			MOVF		PORTD,W
			MOVWF		SSPBUF
			BANKSEL		TRISA
			BTFSS		SSPSTAT,BF
			GOTO		$-1
			BANKSEL		PORTA
			MOVF		SSPBUF,W
			MOVWF		CCPR1L
;
		;----Se envia 8bits ADC y se recibe 2Bits ADC(Se muestra en PWM)
			MOVLW		b'00010101'
			MOVWF		ADCON0
			NOP
			BSF			ADCON0,GO
			BTFSC		ADCON0,GO
			GOTO		$-1
			MOVF		ADRESH,W
			MOVWF		SSPBUF
			BANKSEL		TRISA
			BTFSS		SSPSTAT,BF
			GOTO		$-1
			BANKSEL		PORTA
			MOVF		SSPBUF,W
			MOVWF		CCP1CON

		;----Se envia 2bits ADC y se recibe basura.
			BANKSEL		TRISA
			MOVF		ADRESL,W
			BANKSEL		PORTA
			MOVWF		LSB
			RRF			LSB,F
			RRF			LSB,F
			RRF			LSB,W
			MOVWF		SSPBUF
			BANKSEL		TRISA
			BTFSS		SSPSTAT,BF
			GOTO		$-1
			BANKSEL		PORTA
			MOVF		SSPBUF,W

		MOVLW		0x80			;10000000
		MOVWF		CCPR1L
		MOVWF		CCPR2L
			
		MOVLW		0x0C			;00001100 =>00SALIDA SIMPLE/00MODO PWM/1100 MODO PWM
		MOVWF		CCP1CON			;SALIDA PWM MEJORADA
		MOVWF		CCP2CON			;SALIDA PWM
		BSF			T2CON,0
		BSF			T2CON,1
		BSF			T2CON,TMR2ON

		GOTO		MAIN			;REGRESO A TRANSFERENCIA

;------FUNCION DE RECEPCION--------		
RECEIVE	NOP
		BANKSEL		TRISA
		BTFSS		SSPSTAT,BF		;TERMINO LA RECEPCION?
		GOTO		$-1
		MOVF		DOUT,W	
		MOVWF		SSPBUF	
		BANKSEL		PORTA
		MOVF		SSPBUF,W		;LECTURA DE DATOS DEL MASTER
		MOVWF		DIN
				;ESCRITURA DE DATOS PARA EL MASTER
		RETURN

;------RETARDO DE 10.25ms---------	
R10MS	NOP
		BANKSEL		PORTA
		MOVLW		0xD8
		MOVWF		TMR0
		BTFSS		INTCON,T0IF
		GOTO		$-1
		BCF			INTCON,T0IF
		RETURN
		END