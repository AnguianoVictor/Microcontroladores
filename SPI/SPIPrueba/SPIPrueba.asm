		PROCESSOR	PIC16F887
		INCLUDE		<P16F887.INC>
		
		__CONFIG _CONFIG1, (_INTRC_OSC_NOCLKOUT & _WDT_OFF & _PWRTE_OFF & _MCLRE_OFF & _CP_OFF & _CPD_OFF & _BOR_OFF & _IESO_OFF & _FCMEN_OFF & _LVP_OFF & _DEBUG_OFF)
		__CONFIG _CONFIG2, (_WRT_OFF & _BOR40V)
		
;----- VARIABLES A UTILIZAR. 
DOUT	EQU		0x21
DIN		EQU		0x22
DUTYON	EQU		0x23
DUTYOFF EQU		0x24
LSB		EQU		0x25
;-----COMIENZO DE PROGRAMA.
		ORG		0x00
		
;-----DESHABILITAR ENTRADAS ANALOGICAS. 
	;------BANCO 3
		BANKSEL		ANSEL
		MOVLW		0x20			;Activando AN5
		MOVWF		ANSEL
		CLRF		ANSELH

;-----REGISTROS DE CONFIGURACION
	;------BANCO 1
		BANKSEL		TRISA
		CLRF		TRISA			;SS=0
		CLRF		TRISB
		MOVLW		b'00010000'
		MOVWF		TRISC			;RC2 como salida CCP1
									;RC3 como salida SCK
									;RC4 como entada de datos SPI SDI
									;RC5 como salida de datos SPI SDO
		MOVLW		0xFF			
		MOVWF		TRISD			;Puerto D como entrada digital.
		MOVLW		0x01			
		MOVWF		TRISE			;RE0 como entrada analogica.
		;----CONFIGURANDO SSPCON2
		MOVLW		0x00
		MOVWF		SSPCON2			;I2C apagado.
		;----CONFIGURANDO SSPSTAT
		MOVLW		0x00		
		MOVWF		SSPSTAT			
		;----CONFIGURANDO TRM0 COMO CONTADOR 
		MOVLW		0xD7				;Prescaler 256 TMR0
		MOVWF		OPTION_REG
		;----CONFIGURANDO REGISTRO ADCON1
		MOVLW		0x00
		MOVWF		ADCON1				;Justificacion izquierda

;-------LIMPIANDO LOS PUERTOS DE ENTRADA/SALIDA	
	;------BANCO 0
		BANKSEL		PORTA
		CLRF		PORTA
		CLRF		PORTB
		CLRF		PORTC
		CLRF		PORTD
		CLRF		PORTE
		;-----LIMPIAR BUFER SPI
		CLRF		SSPBUF
		;-----HABILITAR INTERRUPCIONES
		BSF			INTCON,T0IE
		;-----CONFIGURANDO SSPCON
		MOVLW		0x20		;CKP=0
		MOVWF		SSPCON
		;-----CONFIGURANDO ADCON0
		MOVLW		0x15		;Fosc/2 AN5 
		MOVWF		ADCON0
		BSF			PORTA,RA5
		
		
;-------INICIO DE FUNCIONALIDAD

MAIN		;---Se envia PORTD y se recibe basura(No se muestra)
				
			BCF			PORTA,RA5			
			MOVF		PORTD,W				;BANCO 0
			MOVWF		SSPBUF				;BANCO 0
			CALL		R10MS
			BANKSEL		PORTA				;BANCO 0
			MOVF		SSPBUF,W
			BSF			PORTA,RA5			;NO SE MUESTRA NADA
			
			
			;---Se envнa 8Bits ADC y se recibe PORTD(Se muestra en PORTB)
			MOVLW		b'00010101'
			MOVWF		ADCON0				;BANCO 0
			NOP
			BSF			ADCON0,GO
			BTFSC		ADCON0,GO
			GOTO		$-1
			BCF			PORTA,RA5
			MOVF		ADRESH,W			;BANCO 0 ENVIO DE DATOS ANALOGICOS. 
			MOVWF		SSPBUF
			CALL		R10MS
			BANKSEL		PORTA
			MOVF		SSPBUF,W
			MOVWF		PORTB				;RECEPCION EN EL PUERTO B
			BSF			PORTA,RA5
;			;---Se envia 2bits ADC y se recibe 8bits ADC(Se muestra en PWM)
			BANKSEL		TRISA
			MOVF		ADRESL,W
			BANKSEL		PORTA
			MOVWF		LSB
			RRF			LSB,F
			RRF			LSB,F
			RRF			LSB,W
			BCF			PORTA,RA5
			MOVWF		SSPBUF
			CALL		R10MS
			BANKSEL		PORTA
			MOVF		SSPBUF,W
			MOVWF		CCPR1L
			BSF			PORTA,RA5
			
			;---Se envнa basura y se recibe 2 bits ADC (Se muestra en PWM)
			BANKSEL		PORTA
			BCF			PORTA,RA5
			MOVLW		0x10
			MOVWF		SSPBUF
			CALL		R10MS
			MOVF		SSPBUF,W
			MOVWF		CCP1CON
			BSF			PORTA,RA5

			CALL		R10MS
			
			MOVLW	0x80			;10000000
		MOVWF	CCPR1L
		MOVWF	CCPR2L
			
		MOVLW	0x0C			;00001100 =>00SALIDA SIMPLE/00MODO PWM/1100 MODO PWM
		MOVWF	CCP1CON			;SALIDA PWM MEJORADA
		MOVWF	CCP2CON			;SALIDA PWM
		BSF		T2CON,0
		BSF		T2CON,1
		BSF		T2CON,TMR2ON
			
		GOTO		MAIN			;REGRESO A TRANSFERENCIA

SEND	BCF			PORTA,RA5
		MOVF		DOUT,W
		MOVWF		SSPBUF
		BANKSEL		TRISA
		BTFSS		SSPSTAT,BF
		GOTO		$-1
		BANKSEL 	PORTA
REC		MOVF		SSPBUF,W
		MOVWF		DIN
		BSF			PORTA,RA5
		CALL		R10MS
		RETURN

;------RETARDO DE 10.25ms		
R10MS	NOP
		BANKSEL		PORTA
		MOVLW		0xD8
		MOVWF		TMR0
		BTFSS		INTCON,T0IF
		GOTO		$-1
		BCF			INTCON,T0IF
		RETURN		
		END
		
		
		
		
		
		