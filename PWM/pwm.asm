		PROCESSOR P16F887
			INCLUDE <P16F887.INC>

			__CONFIG _CONFIG1, (_INTRC_OSC_NOCLKOUT & _WDT_OFF & _PWRTE_OFF & _MCLRE_OFF & _CP_OFF & _CPD_OFF & _BOR_OFF & _IESO_OFF & _FCMEN_OFF & _LVP_OFF & _DEBUG_OFF)
			__CONFIG _CONFIG2, (_WRT_OFF &_BOR40V)

VA		EQU		0x20
VB  	    EQU		0x21
CONTC		EQU		0x22

			ORG		0x00; PWM
			
			BANKSEL	ANSEL
			MOVLW	0x03
			MOVWF	ANSEL
			CLRF	ANSELH
			
			BANKSEL	TRISA
			MOVLW	0x70
			MOVF	OSCCON
			MOVLW	0x03
			MOVWF	TRISA
			CLRF	TRISB
			CLRF	TRISC
			CLRF	TRISD
			CLRF	TRISE
			
			CLRF	ADCON1
			MOVLW	0xBF
			MOVWF	PR2
			
			BANKSEL	PORTA
			
			MOVLW	0x80			;10000000
			MOVWF	CCPR1L
			MOVWF	CCPR2L
			
			MOVLW	0x0C			;00001100 =>00SALIDA SIMPLE/00MODO PWM/1100 MODO PWM
			MOVWF	CCP1CON			;SALIDA PWM MEJORADA
			MOVWF	CCP2CON			;SALIDA PWM
			
			BSF		T2CON,0
			BSF		T2CON,1
			BSF		T2CON,TMR2ON
	E_IP	BTFSS	PIR1, TMR2IF
			GOTO	E_IP
			
	C_P		MOVLW	0xD4			;C0/ENTRADA ANALOGICA AN5d4
			MOVWF	ADCON0
			BSF		ADCON0, ADON
			BSF		ADCON0, GO_DONE
	E_C0	BTFSC	ADCON0, GO_DONE
			GOTO	E_C0
			MOVF	ADRESH, W
			MOVWF	CCPR1L
			BCF		ADCON0, ADON
			
			MOVLW	0xD8			;D8;C4/ENTRADA ANALOGICA AN6d8
			MOVWF	ADCON0
			BSF		ADCON0, ADON
			BSF		ADCON0, GO_DONE
	E_C1	BTFSC	ADCON0, GO_DONE
			GOTO	E_C1
			MOVF	ADRESH, W
			MOVWF	CCPR2L
			BCF		ADCON0, ADON
			
			CALL	RET
			GOTO	C_P
			
	RET			MOVLW	0x04;04
			MOVWF   VB
	CI_B	MOVLW 	0xFA;FA
			MOVWF	VA
	CI_A	NOP
			DECFSZ  VA,F
			GOTO	CI_A
			DECFSZ	VB,F
			GOTO	CI_B
			
			RETURN
			
			
END